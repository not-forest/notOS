/**
  * Memory are definitions for x86.
  *
  * Copyright (c) 2026 not-forest
  *
  * THE SOFTWARE IS PROVIDED "AS IS", WITHOUT WARRANTY OF ANY KIND, EXPRESS OR
  * IMPLIED, INCLUDING BUT NOT LIMITED TO THE WARRANTIES OF MERCHANTABILITY,
  * FITNESS FOR A PARTICULAR PURPOSE AND NONINFRINGEMENT. IN NO EVENT SHALL THE
  * AUTHORS OR COPYRIGHT HOLDERS BE LIABLE FOR ANY CLAIM, DAMAGES OR OTHER
  * LIABILITY, WHETHER IN AN ACTION OF CONTRACT, TORT OR OTHERWISE, ARISING FROM,
  * SOFTWARE.
  * OUT OF OR IN CONNECTION WITH THE SOFTWARE OR THE USE OR OTHER DEALINGS IN THE
  **/

MEMORY
{
    boot0 (rx)  : ORIGIN = 0x7c00, LENGTH = 512     /* First stage bootloader (MBR sector) */
    boot1 (rx)  : ORIGIN = 0x7e00, LENGTH = 600K    /* Second stage bootloader */
    kernel (rx) : ORIGIN = 0x100000, LENGTH = 15M   /* Kernel start address  */
}
